## config/boards/shields/corne/Kconfig.defconfig
```kconfig
if SHIELD_CORNE_LEFT

config ZMK_KEYBOARD_NAME
    default "Corne"

config ZMK_SPLIT_ROLE_CENTRAL
    default y

endif

if SHIELD_CORNE_RIGHT

config ZMK_KEYBOARD_NAME
    default "Corne Right"

endif


config ZMK_SPLIT
    default y

if ZMK_DISPLAY

config I2C
    default y

config SSD1306
    default y

endif # ZMK_DISPLAY
```

## config/boards/shields/corne/Kconfig.shield
```kconfig
# Copyright (c) 2020 Pete Johanson
# SPDX-License-Identifier: MIT

config SHIELD_CORNE_LEFT
    def_bool true

config SHIELD_CORNE_RIGHT
    def_bool true
```

## config/west.yml
```yaml
manifest:
  version: 0.7
  remotes:
    - name: zmkfirmware
      url-base: https://github.com/zmkfirmware
    - name: juanmihdz
      url-base: https://github.com/juanmihdz
  projects:
    - name: zmk
      remote: zmkfirmware
      revision: main
      import: app/west.yml
  self:
    path: config
```

## west.yml
```yaml
manifest:
  version: 0.7
  remotes:
    - name: zmkfirmware
      url-base: https://github.com/zmkfirmware
  projects:
    - name: zmk
      repo-path: app
      revision: main
      path: zmk
    - name: corneV3-ZMK
      repo-path: corneV3-ZMK
      revision: main
      path: boards/shields/corne
  self:
    path: config
```
